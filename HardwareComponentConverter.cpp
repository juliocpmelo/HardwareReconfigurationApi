
#include "HardwareComponentCoverter.h"


HardwareComponentCoverter::HardwareComponentCoverter(){

}

void HardwareComponentCoverter::convertToVerilog(string projectPath){

}



void HardwareComponentConverter::someFunction(){
std::vector<sc_object*> children = processor->get_child_objects(); 
	std::vector<sc_interface*> IfRefs;
	//get_child_port_ifs(processor);
	//
	modulesLeft.push_back(processor);
	while (!modulesLeft.empty()){
		sc_module* actualModule = modulesLeft.front();
		std::vector<sc_module*> childModules = processStructure(actualModule);
		modulesLeft.pop_front();
		for (std::vector<sc_module*>::iterator i = childModules.begin(); i != childModules.end(); i++){
			processConnections(actualModule, *i);
		}
	}
}

std::string HardwareComponentConverter:translateType(HardwareComponent:DataType type, int size){
	stringstream convertedType;
	switch (type){
		case HardwareComponent:DataType_vector:{
			convertedType<<"std_logic_vector("<<size-1<<" downto 0)"<<endl;
		}
		case HardwareComponent:DataType_bit:{
			convertedType<<"std_logic"<<endl;
		}
		case HardwareComponent:DataType_integer:{
			convertedType<<"std_logic_vector("<<size-1<<" downto 0)"<<endl;
		}
	}
}

std::string HardwareComponentConverter:translatePort(sc_port_base* port){
	
	stringstream convertedPort;

	if(strcmp(port->kind(),"sc_in") == 0){
		designFile <<"\t"<<port->name<<": in ";
		sc_attribute<int> size = port->get_attribute("PortSize");
		sc_attribute<HardwareComponent::DataType> type = port->get_attribute("PortType");
		type = translateType(type,size);
		<<it->second<<";"<<endl;
	}


}

std::map<std::string, std::string > * HardwareComponentCoverter::getPortsTable(HardwareComponent *comp) {
	std::vector<sc_port_base* > *ports = new vector<>;
	std::cout<<"Processing Module "<<module->name()<<std::endl;
	std::vector<sc_object*> children = module->get_child_objects();
	std::vector<sc_module*> childModules;
	for (std::vector<sc_object*>::iterator i = children.begin(); i != 
			children.end(); i++) {
		if ( std::string((*i)->kind())=="sc_in" || 
				std::string((*i)->kind())=="sc_out" || 
				std::string((*i)->kind())=="sc_inout" ) {
			
			sc_port_base* mptr = dynamic_cast<sc_port_base*>(*i);
//			get_child_port_ifs(mptr);
			ports.push_back(mptr);
		}
	}
	return ports;
}


void HardwareComponentCoverter::convertToVhdl(string projectPath, HardwareComponent topComponent){
    ofstream designFile;
    string fileLocation = projectPath+entityNameStr+".vhdl";
    designFile.open (fileLocation.c_str());
    designFile <<"-- This file was auto generated by the HardwareProjectXmlParser"<<endl<<endl;
    designFile <<"library ieee, combinationalLibrary;"<<endl;
    designFile <<"use ieee.std_logic_1164.all;"<<endl;
    designFile <<"use ieee.std_logic_unsigned.all;"<<endl<<endl;

		/* by default dont generate main entity with generics
    designFile <<"entity "<<entityNameStr<<" is"<<endl; //TODO place the main tag name here
    if(genericTable.size() > 0){
        designFile <<"generic ("<<endl;
        map<string, pair<string,string> >::iterator lastElement = genericTable.end();
        lastElement --;
        for(map<string, pair<string,string> >::iterator it = genericTable.begin(); it != lastElement; it++){
            if(it->second.second == "") //has no default value
                designFile <<"\t"<<it->first<<" : "<<it->second.first<<";"<<endl;
            else
                designFile <<"\t"<<it->first<<" : "<<it->second.first<<" := "<<it->second.second<<";"<<endl;
        }
        if(lastElement->second.second == "") //has no default value
                designFile <<"\t"<<lastElement->first<<" : "<<lastElement->second.first<<";"<<endl;
        else
            designFile <<"\t"<<lastElement->first<<" : "<<lastElement->second.first<<" := "<<lastElement->second.second<<endl;
        designFile <<");"<<endl;
    }
    designFile <<"port ("<<endl;

		*/
    /*generate the header of the entity with the input/outputs*/

		
    std::map<std::string, std::string > *portsTable = getPortsTable(topComponent);
		
    if(inputTable.size() > 0 && outputTable.size() > 0){
        map<string, string >::iterator lastElement = outputTable.end();
        lastElement --;
        for(map<string, string >::iterator it = inputTable.begin(); it != inputTable.end(); it++){
            designFile <<"\t"<<it->first<<": in "<<it->second<<";"<<endl;
        }
        for(map<string, string >::iterator it = outputTable.begin(); it != lastElement; it++){
           designFile <<"\t"<<it->first<<": out "<<it->second<<";"<<endl;
        }
        designFile <<"\t"<<lastElement->first<<": out "<<lastElement->second<<endl;
    }
    else if(inputTable.size() > 0){
        map<string, string >::iterator lastElement = inputTable.end();
        lastElement --;
        for(map<string, string >::iterator it = inputTable.begin(); it != lastElement; it++){
            designFile <<"\t"<<it->first<<": in "<<it->second<<";"<<endl;
        }
        designFile <<"\t"<<lastElement->first<<": out "<<lastElement->second<<endl;
    }
    else if(outputTable.size() > 0){
        map<string, string >::iterator lastElement = outputTable.end();
        lastElement --;
        for(map<string, string >::iterator it = outputTable.begin(); it != lastElement; it++){
            designFile <<"\t"<<it->first<<": out "<<it->second<<";"<<endl;
        }
        designFile <<"\t"<<lastElement->first<<": out "<<lastElement->second<<endl;
    }
    designFile <<");"<<endl;
    designFile <<"end "<<entityNameStr<<";"<<endl<<endl;

    designFile<<"architecture arch of "<<entityNameStr<<" is"<<endl;

    /*generate the component declaration in the architecture file*/
    for(set<HardwareComponent::HardwareComponentInfo*>::iterator it = usedComponensInfo.begin(); it!= usedComponentsInfo.end(); it ++){
        designFile<<"\t"<<"component "<<it->first.name<<endl;
				/*
        map<string, pair<string,string> > genericInputs = it->first.genericTable;
        if(genericInputs.size() > 0){
            designFile <<"\t\tgeneric ("<<endl;
            map<string, pair<string,string> >::iterator lastElement = genericInputs.end();
            lastElement --;
            for(map<string, pair<string,string> >::iterator it = genericInputs.begin(); it != lastElement; it++){
                if(it->second.second == "") //has no default value
                    designFile <<"\t\t\t"<<it->first<<" : "<<it->second.first<<";"<<endl;
                else
                    designFile <<"\t\t\t"<<it->first<<" : "<<it->second.first<<" := "<<it->second.second<<";"<<endl;
            }
            if(lastElement->second.second == "") //has no default value
                    designFile <<"\t\t\t"<<lastElement->first<<" : "<<lastElement->second.first<<";"<<endl;
            else
                designFile <<"\t\t\t"<<lastElement->first<<" : "<<lastElement->second.first<<" := "<<lastElement->second.second<<endl;
						
            designFile <<"\t\t);"<<endl;
						
        }*/
        designFile<<"\t\t"<<"port( "<<endl;

				/*
        vector< pair<string,string> > inputPorts = it->first.inputs;
        vector< pair<string,string> > outputPorts = it->first.outputs;
        if(inputPorts.size() > 0 && outputPorts.size() > 0){
            for(vector< pair<string,string> >::iterator it2 = inputPorts.begin(); it2!= inputPorts.end(); it2 ++){
                designFile<<"\t\t\t"<<it2->first<<": in "<<it2->second<<";"<<endl;
            }
            vector< pair<string,string> >::iterator lastElement = outputPorts.end();
            lastElement--;
            for(vector< pair<string,string> >::iterator it2 = outputPorts.begin(); it2!= lastElement; it2 ++){
                designFile<<"\t\t\t"<<it2->first<<": out "<<it2->second<<";"<<endl;
            }
            designFile<<"\t\t\t"<<lastElement->first<<": out "<<lastElement->second<<endl;
        }
        else if(inputPorts.size() > 0){
            vector< pair<string,string> >::iterator lastElement = inputPorts.end();
            lastElement--;
            for(vector< pair<string,string> >::iterator it2 = inputPorts.begin(); it2!= lastElement; it2 ++){
                designFile<<"\t\t\t"<<it2->first<<": in "<<it2->second<<";"<<endl;
            }
            designFile<<"\t\t\t"<<lastElement->first<<": in "<<lastElement->second<<endl;
        }
        else if(outputPorts.size() > 0){
            vector< pair<string,string> >::iterator lastElement = outputPorts.end();
            lastElement--;
            for(vector< pair<string,string> >::iterator it2 = outputPorts.begin(); it2!= lastElement; it2 ++){
                designFile<<"\t\t\t"<<it2->first<<": out "<<it2->second<<";"<<endl;
            }
            designFile<<"\t\t\t"<<lastElement->first<<": out "<<lastElement->second<<endl;
        }*/
        designFile<<"\t\t"<<");"<<endl;
        designFile<<"\tend component;"<<endl;

    }
    
		vector<sc_resolved_signal> signals = getSignals(topComponent);
    for(vector<sc_resolved_signal>::iterator it = signals.begin(); it!= signals.end(); it ++){
			string translation = getTranslation(*it,HardwareConverterLanguages_vhdl);
			designFile<<"\t"<<translation<<endl;
      //designFile<<"\t"<<"signal "<<it->first<<" : "<<it->second<<";"<<endl;
    }
  //  for(set<SignalComponent,SignalComponentCompare>::iterator it = signalList.begin(); it!= signalList.end(); it ++){
   //     designFile<<"\t"<<"signal "<<it->name<<" : "<<it->type<<";"<<endl;
   // }
		
    designFile<<"begin"<<endl;
/*
    for(map<Component, vector<ComponentInstance>, ComponentCompare >::iterator it = componentTable.begin(); it!= componentTable.end(); it ++){
        vector<ComponentInstance>::iterator instanceIt;
        for(instanceIt = it->second.begin(); instanceIt != it->second.end(); instanceIt ++){
            if(instanceIt->portMaps.size() > 0){ //dont initialize a component without binds
                designFile<<instanceIt->name<<" : "<<it->first.name<<endl;
                if(instanceIt->genericMaps.size() > 0){
                    designFile<<"generic map ("<<endl;
                    vector<pair<string,string> >::iterator lastElement = instanceIt->genericMaps.end();
                    lastElement --;
                    bool useGenericNames = false;
                    if(instanceIt->genericMaps.begin()->first != "") //if the first one uses the format genericName => value the others must use it too
                        useGenericNames = true;
                    for(vector<pair<string,string> >::iterator genericIt = instanceIt->genericMaps.begin(); genericIt != lastElement; genericIt ++){
                        if(useGenericNames)
                            designFile<<genericIt->first<<" => "<<genericIt->second<<endl;
                        else
                            designFile<<genericIt->second<<endl;
                    }
                    if(useGenericNames)
                        designFile<<lastElement->first<<" => "<<lastElement->second<<endl;
                    else
                        designFile<<lastElement->second<<endl;
                    designFile<<")"<<endl;
                }
                designFile<<"port map ("<<endl;
               
                vector<pair<string,string> >::iterator lastElement = instanceIt->portMaps.end();
                lastElement --;
                bool usePortNames = false;
                if(instanceIt->portMaps.begin()->first != "") //if the first one uses the format portName => value the others must use it too
                    usePortNames = true;
                for(vector<pair<string,string> >::iterator genericIt = instanceIt->portMaps.begin(); genericIt != lastElement; genericIt ++){
                    if(usePortNames)
                        designFile<<genericIt->first<<" => "<<genericIt->second<<endl;
                    else
                        designFile<<genericIt->second<<endl;
                }
                if(usePortNames)
                    designFile<<lastElement->first<<" => "<<lastElement->second<<endl;
                else
                    designFile<<lastElement->second<<endl;
                designFile<<")"<<endl;
            
                designFile<<");"<<endl<<endl;
            }
        }
    }

    for(vector< pair<string,string> >::iterator it = signalMaps.begin(); it!=signalMaps.end(); it++){
        designFile<<it->first<<" <= "<<it->second<<";"<<endl;
    }
    designFile<<endl;
*/
    designFile<<"end arch;"<<endl;
    
    designFile.close();
    cout<<"design file saved to "<<fileLocation<<endl;

}


