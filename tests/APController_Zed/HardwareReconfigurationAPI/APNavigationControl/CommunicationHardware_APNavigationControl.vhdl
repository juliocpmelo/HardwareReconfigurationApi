-- This file was auto generated by the CommunicationHardwareGenerator

library ieee;
use ieee.std_logic_1164.all;
use ieee.std_logic_unsigned.all;

-- Entity Declaration

entity APNavigationControl_communicationHardware is
generic (
	commHardware_addressWidth : integer := 32;
	commHardware_dataWidth : integer := 32
);
port (
	commHardware_address: in std_logic_vector(commHardware_addressWidth - 1 downto 0);
	commHardware_clk: in std_logic;
	commHardware_dataIn: in std_logic_vector(commHardware_dataWidth - 1 downto 0);
	commHardware_dataOut: out std_logic_vector(commHardware_dataWidth - 1 downto 0);
	commHardware_mode: in std_logic
);
end APNavigationControl_communicationHardware;

-- Entity Declaration end

architecture arch of APNavigationControl_communicationHardware is
-- Register Declaration

signal ABVectorX_reg : std_logic_vector(31 downto 0);
signal ABVectorY_reg : std_logic_vector(31 downto 0);
signal K_L1_reg : std_logic_vector(31 downto 0);
signal L1_dist_reg : std_logic_vector(31 downto 0);
signal L1_dist_min_reg : std_logic_vector(31 downto 0);
signal airUnitVectorX_reg : std_logic_vector(31 downto 0);
signal airUnitVectorY_reg : std_logic_vector(31 downto 0);
signal bearing_error_reg : std_logic_vector(31 downto 0);
signal groundspeed_reg : std_logic_vector(31 downto 0);
signal gsVectorX_reg : std_logic_vector(31 downto 0);
signal gsVectorY_reg : std_logic_vector(31 downto 0);
signal last_nu_reg : std_logic_vector(31 downto 0);
signal lateral_acceleration_dem_reg : std_logic_vector(31 downto 0);
signal max_nu_reg : std_logic_vector(31 downto 0);
signal min_nu_reg : std_logic_vector(31 downto 0);
signal nav_bearing_reg : std_logic_vector(31 downto 0);
signal nav_bearing_cd_condition_reg : std_logic;
signal nu_reg : std_logic_vector(31 downto 0);
signal nu_limit_reg : std_logic_vector(31 downto 0);
signal sin_nu1_max_reg : std_logic_vector(31 downto 0);
signal sin_nu1_min_reg : std_logic_vector(31 downto 0);
signal wpa_reference_reg : std_logic;
begin
-- Main Entity Portmap

WP_L1_NavigationController_inst : entity work.WP_L1_NavigationController
 port map (
ABVectorX => ABVectorX_reg,
ABVectorY => ABVectorY_reg,
K_L1 => K_L1_reg,
L1_dist => L1_dist_reg,
L1_dist_min => L1_dist_min_reg,
airUnitVectorX => airUnitVectorX_reg,
airUnitVectorY => airUnitVectorY_reg,
bearing_error => bearing_error_reg,
clk => commHardware_clk,
groundspeed => groundspeed_reg,
gsVectorX => gsVectorX_reg,
gsVectorY => gsVectorY_reg,
last_nu => last_nu_reg,
lateral_acceleration_dem => lateral_acceleration_dem_reg,
max_nu => max_nu_reg,
min_nu => min_nu_reg,
nav_bearing => nav_bearing_reg,
nav_bearing_cd_condition => nav_bearing_cd_condition_reg,
nu => nu_reg,
nu_limit => nu_limit_reg,
sin_nu1_max => sin_nu1_max_reg,
sin_nu1_min => sin_nu1_min_reg,
wpa_reference => wpa_reference_reg
);

-- Read process from communication hardware

readProcess: process(commHardware_clk)
begin
if rising_edge(commHardware_clk) and commHardware_mode ='0' then
	if commHardware_address = x"0000000" & x"0" then
		commHardware_dataOut	<= x"000000" & x"2e";
	elsif commHardware_address = x"0000000" & x"1" then
		commHardware_dataOut	<= ABVectorX_reg;
	elsif commHardware_address = x"0000000" & x"2" then
		commHardware_dataOut	<= ABVectorY_reg;
	elsif commHardware_address = x"0000000" & x"3" then
		commHardware_dataOut	<= K_L1_reg;
	elsif commHardware_address = x"0000000" & x"4" then
		commHardware_dataOut	<= L1_dist_reg;
	elsif commHardware_address = x"0000000" & x"5" then
		commHardware_dataOut	<= L1_dist_min_reg;
	elsif commHardware_address = x"0000000" & x"6" then
		commHardware_dataOut	<= airUnitVectorX_reg;
	elsif commHardware_address = x"0000000" & x"7" then
		commHardware_dataOut	<= airUnitVectorY_reg;
	elsif commHardware_address = x"0000000" & x"8" then
		commHardware_dataOut	<= bearing_error_reg;
	elsif commHardware_address = x"0000000" & x"9" then
		commHardware_dataOut	<= groundspeed_reg;
	elsif commHardware_address = x"0000000" & x"a" then
		commHardware_dataOut	<= gsVectorX_reg;
	elsif commHardware_address = x"0000000" & x"b" then
		commHardware_dataOut	<= gsVectorY_reg;
	elsif commHardware_address = x"0000000" & x"c" then
		commHardware_dataOut	<= last_nu_reg;
	elsif commHardware_address = x"0000000" & x"d" then
		commHardware_dataOut	<= lateral_acceleration_dem_reg;
	elsif commHardware_address = x"0000000" & x"e" then
		commHardware_dataOut	<= max_nu_reg;
	elsif commHardware_address = x"0000000" & x"f" then
		commHardware_dataOut	<= min_nu_reg;
	elsif commHardware_address = x"000000" & x"10" then
		commHardware_dataOut	<= nav_bearing_reg;
	elsif commHardware_address = x"000000" & x"11" then
		commHardware_dataOut	<= x"0000000" & b"000" & nav_bearing_cd_condition_reg;
	elsif commHardware_address = x"000000" & x"12" then
		commHardware_dataOut	<= nu_reg;
	elsif commHardware_address = x"000000" & x"13" then
		commHardware_dataOut	<= nu_limit_reg;
	elsif commHardware_address = x"000000" & x"14" then
		commHardware_dataOut	<= sin_nu1_max_reg;
	elsif commHardware_address = x"000000" & x"15" then
		commHardware_dataOut	<= sin_nu1_min_reg;
	elsif commHardware_address = x"000000" & x"16" then
		commHardware_dataOut	<= x"0000000" & b"000" & wpa_reference_reg;
	end if;
end if;
end process readProcess;

-- Write process from communication hardware

writeProcess: process(commHardware_clk)
begin
if rising_edge(commHardware_clk) and commHardware_mode ='1' then
	if commHardware_address = x"0000000" & x"1" then
		ABVectorX_reg <= commHardware_dataIn(31 downto 0);
	elsif commHardware_address = x"0000000" & x"2" then
		ABVectorY_reg <= commHardware_dataIn(31 downto 0);
	elsif commHardware_address = x"0000000" & x"3" then
		K_L1_reg <= commHardware_dataIn(31 downto 0);
	elsif commHardware_address = x"0000000" & x"4" then
		L1_dist_reg <= commHardware_dataIn(31 downto 0);
	elsif commHardware_address = x"0000000" & x"5" then
		L1_dist_min_reg <= commHardware_dataIn(31 downto 0);
	elsif commHardware_address = x"0000000" & x"6" then
		airUnitVectorX_reg <= commHardware_dataIn(31 downto 0);
	elsif commHardware_address = x"0000000" & x"7" then
		airUnitVectorY_reg <= commHardware_dataIn(31 downto 0);
	elsif commHardware_address = x"0000000" & x"9" then
		groundspeed_reg <= commHardware_dataIn(31 downto 0);
	elsif commHardware_address = x"0000000" & x"a" then
		gsVectorX_reg <= commHardware_dataIn(31 downto 0);
	elsif commHardware_address = x"0000000" & x"b" then
		gsVectorY_reg <= commHardware_dataIn(31 downto 0);
	elsif commHardware_address = x"0000000" & x"e" then
		max_nu_reg <= commHardware_dataIn(31 downto 0);
	elsif commHardware_address = x"0000000" & x"f" then
		min_nu_reg <= commHardware_dataIn(31 downto 0);
	elsif commHardware_address = x"000000" & x"11" then
		nav_bearing_cd_condition_reg <= commHardware_dataIn(0);
	elsif commHardware_address = x"000000" & x"13" then
		nu_limit_reg <= commHardware_dataIn(31 downto 0);
	elsif commHardware_address = x"000000" & x"14" then
		sin_nu1_max_reg <= commHardware_dataIn(31 downto 0);
	elsif commHardware_address = x"000000" & x"15" then
		sin_nu1_min_reg <= commHardware_dataIn(31 downto 0);
	elsif commHardware_address = x"000000" & x"16" then
		wpa_reference_reg <= commHardware_dataIn(0);
	end if;
end if;
end process writeProcess;
end arch;
